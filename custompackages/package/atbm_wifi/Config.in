## custompackages/package/atbm_wifi/Config.in
```kconfig
config BR2_PACKAGE_ATBM_WIFI
	bool "atbm_wifi"
	depends on BR2_LINUX_KERNEL
	help
	  This module allows you to create "ATBM WiFi module".
	  https://github.com/gtxaspec/atbm_wifi

comment "atbm wifi needs a Linux kernel to be built"
	depends on !BR2_LINUX_KERNEL
```

## custompackages/package/busybox-init/Config.in
```kconfig
config BR2_PACKAGE_BUSYBOX_INIT
	bool "BusyBox-init"
	default y
	help
	  The Swiss Army Knife of embedded Linux. It slices, it dices, it
	  makes Julian Fries.

	  http://busybox.net/

	  Most people will answer Y.

if BR2_PACKAGE_BUSYBOX_INIT

config BR2_PACKAGE_BUSYBOX_INIT_CONFIG
	string "BusyBox-init configuration file to use?"
	default "/src/configs/busybox-init.config"
	help
	  Some people may wish to use their own modified BusyBox configuration
	  file, and will specify their config file location with this option.

	  Most people will just use the default BusyBox configuration file.

config BR2_PACKAGE_BUSYBOX_INIT_SHOW_OTHERS
	bool "Show packages that are also provided by busybox-init"
	help
	  Show packages in menuconfig that are potentially also provided
	  by busybox.
endif

if !BR2_PACKAGE_BUSYBOX_INIT # kconfig doesn't support else

# add dummy config so the stuff with busybox alternatives are shown
# when busybox is disabled
config BR2_PACKAGE_BUSYBOX_INIT_SHOW_OTHERS
	default y
endif
```

## custompackages/package/dosfstools-init/Config.in
```kconfig
config BR2_PACKAGE_DOSFSTOOLS_INIT
	bool "dosfstools-init"
	help
	  Tools for initramfs checking DOS FAT filesystems.

	  https://github.com/dosfstools/dosfstools
```

## custompackages/package/rtl8189es_linux/Config.in
```kconfig
config BR2_PACKAGE_RTL8189ES_LINUX
	bool "rtl8189es_linux"
	depends on BR2_LINUX_KERNEL
	help
	  This module allows you to create "RTL8189ES WiFi module".
	  https://github.com/gtxaspec/rtl8189ES_linux

comment "RTL8189ES wifi needs a Linux kernel to be built"
	depends on !BR2_LINUX_KERNEL
```
